## px4_rplidar/src/drivers/distance_sensor/rplidar/Kconfig
```kconfig
menuconfig DRIVERS_DISTANCE_SENSOR_RPLIDAR
	bool "rplidar"
	default n
	---help---
		Enable support for Slamtec RPLidar 360 degree laser scanners
```

## px4_rplidar/src/modules/aid_switch/Kconfig
```kconfig
menuconfig MODULES_AID_SWITCH
	bool "aid_switch"
	default n
	---help---
		Select the EKF2 position source (GPS, GPS + optical flow, optical flow) from an RC switch
```
